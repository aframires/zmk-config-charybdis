/*
 * Copyright (c) 2024 The ZMK Contributors
 * SPDX-License-Identifier: MIT
 * 
 * Common trackball input processor configurations for Charybdis keyboard
 * This file defines the standard processing for snipe, scroll, and move modes
 * 
 * Usage: include this file and expand CHARYBDIS_TRACKBALL_PROCESSORS inside
 * a `zmk,input-listener` node (see charybdis_right_standalone.overlay).
 */

#include "charybdis_layers.h"
#include <dt-bindings/zmk/input_transform.h>
#include <input/processors.dtsi>
#include <behaviors/input_gestures_accel.dtsi>

&pointer_accel {
    input-type = <INPUT_EV_REL>;
    track-remainders;
    min-factor = <900>;         /* 0.9x at slow speeds for faster precision */
    max-factor = <3000>;        /* 3.0x at high speeds for a faster peak */
    speed-threshold = <1000>;   /* Counts per second before acceleration kicks in */
    speed-max = <6000>;         /* Counts per second at which max acceleration is reached */
    acceleration-exponent = <1>; /* Linear curve for smoother, more predictable ramp */
};

/ {
    trackball_temp_layer: trackball_temp_layer {
        compatible = "zmk,input-processor-temp-layer";
        #input-processor-cells = <2>;
    };
};

// Standard trackball processing configuration
// Can be used in both standalone (trackball_listener) and dongle mode (input_split_listener)
#define CHARYBDIS_TRACKBALL_PROCESSORS \
    snipe { \
        layers = <SNIPING>; \
        input-processors = <&zip_xy_scaler 1 3>; \
    }; \
    \
    scroll { \
        layers = <SCROLL>; \
        input-processors = <&zip_xy_transform (INPUT_TRANSFORM_Y_INVERT)>, <&pointer_accel>, <&zip_xy_scaler 1 40>, <&zip_xy_to_scroll_mapper>; \
    }; \
    \
    move { \
        layers = <BASE NAV SYM ADJ MOUSE>; \
        input-processors = <&pointer_accel>, <&trackball_temp_layer MOUSE 500>; \
    };
