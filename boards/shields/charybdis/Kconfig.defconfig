## boards/shields/charybdis/Kconfig.defconfig
```kconfig
if SHIELD_CHARYBDIS_RIGHT_STANDALONE

config ZMK_KEYBOARD_NAME
	default "Charybdis"

config ZMK_SPLIT_BLE_ROLE_CENTRAL
	default y

endif

if SHIELD_DONGLE_CHARYBDIS_RIGHT

config ZMK_KEYBOARD_NAME
	default "Charybdis Right"

endif

if SHIELD_DONGLE_PROSPECTOR || SHIELD_DONGLE_BWSHOCKLEY_PROSPECTOR

config ZMK_KEYBOARD_NAME
	default "Charybdis"

config ZMK_SPLIT_BLE_ROLE_CENTRAL
	default y

endif

if SHIELD_DONGLE_NICE

config ZMK_KEYBOARD_NAME
	default "Charybdis"

config ZMK_SPLIT_BLE_ROLE_CENTRAL
	default y

endif

if CHARYBDIS_RGB && (SHIELD_CHARYBDIS_LEFT || SHIELD_CHARYBDIS_RIGHT_STANDALONE || SHIELD_DONGLE_CHARYBDIS_RIGHT)

config SPI
	default y

config LED_STRIP
	default y

config ZMK_RGB_UNDERGLOW
	default y

config ZMK_EXT_POWER
	default y

config ZMK_RGB_UNDERGLOW_ON_START
	default n

config ZMK_RGB_UNDERGLOW_EXT_POWER
	default y

config ZMK_RGB_UNDERGLOW_EFF_START
	default 2

config ZMK_RGB_UNDERGLOW_BRT_START
	default 25

endif



if SHIELD_CHARYBDIS_LEFT || SHIELD_CHARYBDIS_RIGHT_STANDALONE || SHIELD_DONGLE_CHARYBDIS_RIGHT || SHIELD_DONGLE_PROSPECTOR || SHIELD_DONGLE_NICE || SHIELD_DONGLE_BWSHOCKLEY_PROSPECTOR

config ZMK_SPLIT
	default y

endif
```

## dts/bindings/behaviors/zmk,behavior-charybdis-rgb.yaml
```yaml
description: Charybdis RGB behavior that can proxy RGB commands from LED-less dongles
compatible: "zmk,behavior-charybdis-rgb"
include: two_param.yaml
```

## dts/bindings/behaviors/zmk,behavior-rgb-local.yaml
```yaml
description: RGB underglow behavior that executes on the key event source side
compatible: "zmk,behavior-rgb-local"
include: two_param.yaml
```
